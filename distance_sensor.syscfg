// These arguments were used when this file was generated. They will be automatically applied on subsequent loads 
// via the GUI or CLI invocations. Run CLI with '--help' for additional information on how to override these arguments.
// @cliArgs --board "/ti/boards/CC3220SF_LAUNCHXL" --product "SimpleLinkSDK@3.20.00.06"
// @versions {"data":"2019051709","timestamp":"2019051709","tool":"1.1.792","templates":"2019051709"}

var RTOS = scripting.addModule("/ti/drivers/RTOS");
var UART = scripting.addModule("/ti/drivers/UART");
var UART1 = UART.addInstance();
var Timer = scripting.addModule("/ti/drivers/Timer");
var Timer1 = Timer.addInstance();
var Capture = scripting.addModule("/ti/drivers/Capture");
var Capture1 = Capture.addInstance();
var GPIO = scripting.addModule("/ti/drivers/GPIO");
var GPIO1 = GPIO.addInstance();
var GPIO2 = GPIO.addInstance();
var GPIO3 = GPIO.addInstance();
var GPIO4 = GPIO.addInstance();
// Name - The C/C++ identifier used in applications as the index parameter passed to UART runtime APIs
UART1.$name = "DISTANCE_SENSOR_UART";
// Name
UART1.uart.$name = "MyUART1";
// Use Peripheral
UART1.uart.$assign = "UART0";
var Power = scripting.addModule("/ti/drivers/Power");
// Name
Power.parkPins.$name = "ti_drivers_power_PowerCC32XXPins0";
var Board = scripting.addModule("/ti/drivers/Board");
// Name - The C/C++ identifier used in applications as the index parameter passed to Timer runtime APIs
Timer1.$name = "DISTANCE_SENSOR_TIMER";
// Timer Type
Timer1.timerType = "32 Bits";
// Name
Timer1.timer.$name = "MyTimer1";
// Use Peripheral
Timer1.timer.$assign = "Timer0";
// Name - The C/C++ identifier used in applications as the index parameter passed to Capture runtime APIs
Capture1.$name = "Board_CAPTURE0";
// Name
Capture1.timer.$name = "MyTimer1";
// Use Peripheral
Capture1.timer.$assign = "Timer2";
// Assign pin
Capture1.timer.capturePin.$assign = "boosterpack.7"; // P05
// Name - The C/C++ identifier used in applications as the index parameter passed to GPIO runtime APIs
GPIO1.$name = "Board_GPIO_LED0";
// Use Hardware - Select the hardware to use, or 'none' to use available header pins
GPIO1.$hardware = system.deviceData.board.components.LED_RED;
// Name - The C/C++ identifier used in applications as the index parameter passed to GPIO runtime APIs
GPIO2.$name = "Board_GPIO0";
// Assign pin
GPIO2.gpioPin.$assign = "boosterpack.4"; // P03
// Name - The C/C++ identifier used in applications as the index parameter passed to GPIO runtime APIs
GPIO3.$name = "Board_GPIO1";
// Assign pin
GPIO3.gpioPin.$assign = "boosterpack.14"; // P06
// Name - The C/C++ identifier used in applications as the index parameter passed to GPIO runtime APIs
GPIO4.$name = "Board_GREEN";
// Use Hardware - Select the hardware to use, or 'none' to use available header pins
GPIO4.$hardware = system.deviceData.board.components.LED_GREEN;
// Suggest solution
UART1.uart.txPin.$suggestSolution = "62";
// Suggest solution
UART1.uart.rxPin.$suggestSolution = "45";
// Suggest solution
GPIO1.gpioPin.$suggestSolution = "64";
// Suggest solution
GPIO4.gpioPin.$suggestSolution = "2";
